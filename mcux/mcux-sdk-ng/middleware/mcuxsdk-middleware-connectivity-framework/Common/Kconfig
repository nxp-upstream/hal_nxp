## mcux/mcux-sdk-ng/middleware/mcuxsdk-middleware-connectivity-framework/Common/Kconfig
```kconfig
# Copyright 2024 NXP
# SPDX-License-Identifier: BSD-3-Clause

# Common configuration options

config MCUX_COMPONENT_middleware.wireless.framework.systicks
    bool "FreeRTOS IDLE hooks for Time Compensation"
    depends on MCUX_COMPONENT_middleware.freertos-kernel
    depends on MCUX_COMPONENT_middleware.wireless.framework.platform
    help
      Those RTOS hooks provides a Pre Idle and Post Idle hooks to ensure timing compensation after low power exit.

config MCUX_COMPONENT_middleware.wireless.framework.heap_mem_manager
    bool "FreeRTOS Heap API wrapper to MCUX SDK memory manager"
    select MCUX_COMPONENT_component.mem_manager
    depends on MCUX_COMPONENT_middleware.freertos-kernel
```

## mcux/mcux-sdk-ng/middleware/mcuxsdk-middleware-connectivity-framework/Kconfig
```kconfig
# Copyright 2024-2025 NXP
# SPDX-License-Identifier: BSD-3-Clause

menuconfig MCUX_COMPONENT_middleware.wireless.framework
    bool "Connectivity Framework"
    help
      Enable the Connectivity Framework for wireless applications

if MCUX_COMPONENT_middleware.wireless.framework

rsource "platform/Kconfig"

menu "Service Modules"

rsource "services/FactoryDataProvider/Kconfig"
rsource "services/FunctionLib/Kconfig"
rsource "services/PDM/Kconfig"
rsource "services/PDUM/Kconfig"
rsource "services/ModuleInfo/Kconfig"
rsource "services/MWSCoexistence/Kconfig"
rsource "services/NVM/Kconfig"
rsource "services/SecLib_RNG/Kconfig"
rsource "services/HWParameter/Kconfig"
rsource "services/Sensors/Kconfig"
rsource "services/OtaSupport/Kconfig"
rsource "services/LowPower/Kconfig"
rsource "services/FSCI/Kconfig"
rsource "services/SFC/Kconfig"
rsource "services/FileSystem/Kconfig"
rsource "services/OTW/Kconfig"
rsource "services/WorkQ/Kconfig"

rsource "zephyr/Kconfig"

endmenu

menu "Extra Modules"

rsource "Common/Kconfig"
rsource "services/DBG/Kconfig"

endmenu

endif
```
