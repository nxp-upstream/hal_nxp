## mcux/mcux-sdk-ng/middleware/mcuxsdk-middleware-connectivity-framework/platform/MIMXRT595S/Kconfig.defconfig
```kconfig
# Copyright 2024-2025 NXP
# SPDX-License-Identifier: BSD-3-Clause

if MCUX_COMPONENT_middleware.wireless.framework.platform.MIMXRT595S

config MCUX_COMPONENT_middleware.wireless.framework.platform.lowpower
    select MCUX_COMPONENT_component.power_manager_framework
    select MCUX_COMPONENT_driver.lpc_rtc
    select MCUX_COMPONENT_driver.power

endif
```

## mcux/mcux-sdk-ng/middleware/mcuxsdk-middleware-connectivity-framework/platform/imx_rt/Kconfig
```kconfig
# Copyright 2024-2025 NXP
# SPDX-License-Identifier: BSD-3-Clause

if MCUX_COMPONENT_middleware.wireless.framework.platform.imx_rt

if MCUX_COMPONENT_middleware.wireless.framework.platform.coex

choice MCUX_COMPONENT_middleware.wireless.framework.platform.coex.transceiver
    prompt "Coex implementation selection for supported transceivers"
    config MCUX_COMPONENT_middleware.wireless.framework.platform.coex.k32w0
        bool "Coex platform support for k32w0 transceiver"
        select MCUX_COMPONENT_component.osa
        select MCUX_COMPONENT_middleware.wireless.framework.otw
        help
            Use coex platform implementation to manage k32w0 controller.
    config MCUX_COMPONENT_middleware.wireless.framework.platform.coex.iw612
        bool "Coex platform support for iw612 transceiver"
        select MCUX_COMPONENT_component.igpio_adapter
        select MCUX_COMPONENT_component.osa
        select MCUX_COMPONENT_middleware.freertos-kernel
        select MCUX_COMPONENT_middleware.wifi.osa_free_rtos
        depends on MCUX_COMPONENT_middleware.wifi.fwdnld
        help
            Use coex platform implementation to manage iw612 controller.
    config MCUX_COMPONENT_middleware.wireless.framework.platform.coex.iw610
        bool "Coex platform support for iw610 transceiver"
        select MCUX_COMPONENT_component.igpio_adapter
        select MCUX_COMPONENT_component.osa
        select MCUX_COMPONENT_middleware.freertos-kernel
        select MCUX_COMPONENT_middleware.wifi.osa_free_rtos
        depends on MCUX_COMPONENT_middleware.wifi.fwdnld
        help
            Use coex platform implementation to manage iw610 controller.
endchoice

endif # MCUX_COMPONENT_middleware.wireless.framework.platform.coex

config MCUX_COMPONENT_middleware.wireless.framework.platform.hdlc
    select MCUX_COMPONENT_middleware.wireless.framework.platform.coex
    select MCUX_COMPONENT_component.serial_manager

config MCUX_COMPONENT_middleware.wireless.framework.platform.ot
    select MCUX_COMPONENT_middleware.wireless.framework.platform.coex

endif # MCUX_COMPONENT_middleware.wireless.framework.platform.imx_rt
```

## mcux/mcux-sdk-ng/middleware/mcuxsdk-middleware-connectivity-framework/platform/kw47_mcxw72_nbu/Kconfig.defconfig
```kconfig
# Copyright 2025 NXP
#
# SPDX-License-Identifier: BSD-3-Clause

if MCUX_COMPONENT_middleware.wireless.framework.platform.kw47_mcxw72_nbu

config MCUX_COMPONENT_middleware.wireless.framework.platform.dcdc

endif
```

## mcux/mcux-sdk-ng/middleware/mcuxsdk-middleware-connectivity-framework/platform/mcxw23/Kconfig.defconfig
```kconfig
# Copyright 2025 NXP
#
# SPDX-License-Identifier: BSD-3-Clause

if MCUX_COMPONENT_middleware.wireless.framework.platform.mcxw23

config MCUX_COMPONENT_middleware.wireless.framework.platform.external_flash
    select MCUX_COMPONENT_component.flash_nor_spifi
    select MCUX_PRJSEG_module.board.wireless.board.extflash

config MCUX_COMPONENT_middleware.wireless.framework.platform.ota
    select MCUX_COMPONENT_driver.romapi

config MCUX_COMPONENT_middleware.wireless.framework.platform.ble
    select MCUX_COMPONENT_driver.romapi
    select MCUX_COMPONENT_middleware.wireless.snps_ll

endif
```

## mcux/mcux-sdk-ng/middleware/mcuxsdk-middleware-connectivity-framework/platform/rt1170/Kconfig.defconfig
```kconfig
# Copyright 2024-2025 NXP
# SPDX-License-Identifier: BSD-3-Clause

if MCUX_COMPONENT_middleware.wireless.framework.platform.rt1170

choice MCUX_COMPONENT_middleware.mbedtls.port.selection
    default MCUX_COMPONENT_middleware.mbedtls.port.ksdk
endchoice

config MCUX_COMPONENT_middleware.wireless.framework.platform.external_flash
    select MCUX_COMPONENT_component.osa

config MCUX_COMPONENT_middleware.wireless.framework.platform.ota
    select MCUX_COMPONENT_middleware.wireless.framework.function_lib

endif # MCUX_COMPONENT_middleware.wireless.framework.platform.rt1170
```

## mcux/mcux-sdk-ng/middleware/mcuxsdk-middleware-connectivity-framework/platform/rw61x/Kconfig.defconfig
```kconfig
# Copyright 2024-2025 NXP
# SPDX-License-Identifier: BSD-3-Clause

if MCUX_COMPONENT_middleware.wireless.framework.platform.rw61x

choice MCUX_COMPONENT_middleware.wireless.framework.seclib_rng_port
    default MCUX_COMPONENT_middleware.wireless.framework.seclib_rng_port.mbedtls
endchoice

choice MCUX_COMPONENT_middleware.mbedtls.port.selection
    default MCUX_COMPONENT_middleware.mbedtls.port.els_pkc
endchoice

config MCUX_COMPONENT_middleware.wireless.framework.platform.external_flash
    select MCUX_COMPONENT_component.osa

config MCUX_COMPONENT_middleware.wireless.framework.seclib_rng_port.psa
    select MCUX_COMPONENT_component.psa_crypto_driver.els_pkc

config MCUX_COMPONENT_middleware.wireless.framework.platform.ble
    select MCUX_COMPONENT_driver.conn_fwloader_ns
    select MCUX_COMPONENT_component.wireless_imu_adapter
    select MCUX_COMPONENT_middleware.wireless.framework.platform.coex
    select MCUX_COMPONENT_component.osa
    depends on MCUX_COMPONENT_middleware.wireless.framework.platform.ot

config MCUX_COMPONENT_middleware.wireless.framework.platform.coex
    select MCUX_COMPONENT_driver.conn_fwloader_ns
    select MCUX_COMPONENT_driver.conn_fwloader

config MCUX_COMPONENT_middleware.wireless.framework.platform.ot
    select MCUX_COMPONENT_middleware.wireless.framework.platform.coex
    select MCUX_COMPONENT_middleware.wireless.framework.platform.hdlc
    select MCUX_COMPONENT_middleware.wireless.framework.platform.ble

config MCUX_COMPONENT_middleware.wireless.framework.platform.hdlc
    select MCUX_COMPONENT_middleware.wireless.framework.platform.coex
    select MCUX_COMPONENT_middleware.wireless.framework.platform.ble
    select MCUX_COMPONENT_component.wireless_imu_adapter
    select MCUX_COMPONENT_component.osa

config MCUX_COMPONENT_middleware.wireless.framework.platform.ota
    select MCUX_COMPONENT_middleware.wireless.framework.function_lib

config MCUX_COMPONENT_middleware.wireless.framework.platform.lowpower
    select MCUX_COMPONENT_middleware.wireless.framework.platform.ble
    select MCUX_COMPONENT_component.wireless_imu_adapter
    select MCUX_COMPONENT_component.osa
    select MCUX_COMPONENT_component.power_manager_framework
    select MCUX_COMPONENT_driver.conn_fwloader_ns
    select MCUX_COMPONENT_driver.flexcomm_usart
    select MCUX_COMPONENT_driver.lpc_rtc
    select MCUX_COMPONENT_utility.debug_console
    select MCUX_COMPONENT_driver.power

config MCUX_COMPONENT_middleware.wireless.framework.platform.zb
    select MCUX_COMPONENT_middleware.wireless.framework.seclib_rng
    select MCUX_COMPONENT_middleware.wireless.framework.pdm
    select MCUX_COMPONENT_middleware.wireless.framework.function_lib
    select MCUX_COMPONENT_component.wireless_imu_adapter
    select MCUX_COMPONENT_component.osa
endif
```

## mcux/mcux-sdk-ng/middleware/mcuxsdk-middleware-connectivity-framework/platform/wireless_mcu/Kconfig.defconfig
```kconfig
# Copyright 2024-2025 NXP
#
# SPDX-License-Identifier: BSD-3-Clause

if MCUX_COMPONENT_middleware.wireless.framework.platform.kw45_k32w1_mcxw71 || MCUX_COMPONENT_middleware.wireless.framework.platform.kw47_mcxw72

choice MCUX_COMPONENT_middleware.wireless.framework.seclib_rng_port
    default MCUX_COMPONENT_middleware.wireless.framework.seclib_rng_port.secure_subsystem
endchoice

config MCUX_COMPONENT_middleware.wireless.framework.seclib_rng_port.secure_subsystem
    select MCUX_COMPONENT_middleware.secure-subsystem.elemu.port_kw45_k4w1

config MCUX_COMPONENT_middleware.wireless.framework.seclib_rng_port.psa
    select MCUX_COMPONENT_component.psa_crypto_driver.ele_s200
    select MCUX_COMPONENT_middleware.secure-subsystem.elemu.crypto_sss_interface

config MCUX_COMPONENT_middleware.wireless.framework.platform.ics
    select MCUX_COMPONENT_middleware.wireless.framework.function_lib
    imply MCUX_COMPONENT_middleware.wireless.framework.workq
    select MCUX_COMPONENT_component.lists
    select MCUX_COMPONENT_component.rpmsg_adapter

config MCUX_COMPONENT_middleware.wireless.framework.platform.rng
    select MCUX_COMPONENT_middleware.wireless.framework.platform.ics

config MCUX_COMPONENT_middleware.wireless.framework.platform.ble
    select MCUX_COMPONENT_middleware.wireless.framework.hw_parameter
    select MCUX_COMPONENT_middleware.wireless.framework.seclib_rng
    select MCUX_COMPONENT_middleware.wireless.framework.platform.ics
    imply MCUX_COMPONENT_middleware.wireless.framework.workq
    imply MCUX_COMPONENT_middleware.wireless.controller_api

config MCUX_COMPONENT_middleware.wireless.framework.platform.external_flash
    select MCUX_COMPONENT_component.flash_nor_lpspi
    select MCUX_PRJSEG_module.board.wireless.board.extflash

config MCUX_COMPONENT_middleware.wireless.framework.platform.internal_flash
    select MCUX_COMPONENT_component.flash_adapter

config MCUX_COMPONENT_middleware.wireless.framework.platform.sensors
    select MCUX_COMPONENT_middleware.wireless.framework.platform.ics
    select MCUX_COMPONENT_device.utility

config MCUX_COMPONENT_middleware.wireless.framework.platform.lowpower
    select MCUX_COMPONENT_component.power_manager_framework
    select MCUX_COMPONENT_middleware.wireless.framework.platform.ics
    select MCUX_COMPONENT_component.mem_manager
    select MCUX_COMPONENT_driver.vbat

config MCUX_COMPONENT_middleware.wireless.framework.platform.lowpower_timer
    select MCUX_COMPONENT_component.timer_manager

config MCUX_COMPONENT_middleware.wireless.framework.platform.ot
    select MCUX_COMPONENT_component.serial_manager
    select MCUX_COMPONENT_middleware.wireless.framework.platform.ics
    select MCUX_COMPONENT_middleware.wireless.framework.hw_parameter
    select MCUX_COMPONENT_middleware.wireless.framework.seclib_rng

config MCUX_COMPONENT_middleware.wireless.framework.platform.reset
    select MCUX_COMPONENT_component.reset_adapter
    select MCUX_COMPONENT_driver.wuu
    select MCUX_COMPONENT_driver.cmc
    select MCUX_COMPONENT_driver.lptmr

config MCUX_COMPONENT_middleware.wireless.framework.platform.ota
    select MCUX_COMPONENT_component.flash_adapter

config MCUX_COMPONENT_middleware.wireless.framework.platform.lcl
    select MCUX_COMPONENT_middleware.wireless.framework.function_lib
    select MCUX_COMPONENT_middleware.wireless.framework.seclib_rng
    select MCUX_COMPONENT_driver.trdc
    select MCUX_COMPONENT_driver.port
    select MCUX_COMPONENT_driver.gpio

config MCUX_COMPONENT_middleware.wireless.framework.platform.zb
    select MCUX_COMPONENT_component.rpmsg_adapter

endif

## KW43

if MCUX_COMPONENT_middleware.wireless.framework.platform.kw43_mcxw70

choice MCUX_COMPONENT_middleware.wireless.framework.seclib_rng_port
    default MCUX_COMPONENT_middleware.wireless.framework.seclib_rng_port.sw
endchoice

config MCUX_COMPONENT_middleware.wireless.framework.platform.ics
    select MCUX_COMPONENT_middleware.wireless.framework.function_lib
    select MCUX_COMPONENT_component.rpmsg_adapter
    imply MCUX_COMPONENT_middleware.wireless.framework.workq

config MCUX_COMPONENT_middleware.wireless.framework.platform.rng
    select MCUX_COMPONENT_middleware.wireless.framework.platform.ics

config MCUX_COMPONENT_middleware.wireless.framework.platform.ble
    #select MCUX_COMPONENT_middleware.wireless.framework.hw_parameter
    select MCUX_COMPONENT_middleware.wireless.framework.seclib_rng
    select MCUX_COMPONENT_middleware.wireless.framework.platform.ics
    imply MCUX_COMPONENT_middleware.wireless.framework.workq
    imply MCUX_COMPONENT_middleware.wireless.controller_api

config MCUX_COMPONENT_middleware.wireless.framework.platform.sensors
    #select MCUX_COMPONENT_middleware.wireless.framework.platform.ics
    #select MCUX_COMPONENT_device.utility

config MCUX_COMPONENT_middleware.wireless.framework.platform.internal_flash
    select MCUX_COMPONENT_component.flash_adapter

config MCUX_COMPONENT_middleware.wireless.framework.platform.ota
    select MCUX_COMPONENT_component.flash_adapter

config MCUX_COMPONENT_middleware.wireless.framework.platform.lcl
    select MCUX_COMPONENT_middleware.wireless.framework.function_lib
    select MCUX_COMPONENT_middleware.wireless.framework.seclib_rng
    #select MCUX_COMPONENT_driver.trdc
    select MCUX_COMPONENT_driver.port
    select MCUX_COMPONENT_driver.gpio

config MCUX_COMPONENT_middleware.wireless.framework.platform.reset
    select MCUX_COMPONENT_component.reset_adapter
    select MCUX_COMPONENT_driver.wuu
    # select MCUX_COMPONENT_driver.cmc
    select MCUX_COMPONENT_driver.lptmr

endif
```
