## mcux/mcux-sdk-ng/middleware/mcuxsdk-middleware-connectivity-framework/platform/wireless_nbu/Kconfig.defconfig
```kconfig
# Copyright 2024-2025 NXP
#
# SPDX-License-Identifier: BSD-3-Clause

# KW45/MCXW71
if MCUX_COMPONENT_middleware.wireless.framework.platform.kw45_mcxw71_nbu

config MCUX_COMPONENT_middleware.wireless.framework.platform.ics
    select MCUX_COMPONENT_middleware.wireless.framework.function_lib
    select MCUX_COMPONENT_middleware.wireless.framework.sfc
    select MCUX_COMPONENT_component.rpmsg_adapter
    imply MCUX_COMPONENT_middleware.wireless.framework.workq
    imply MCUX_COMPONENT_component.mem_manager
    imply MCUX_COMPONENT_component.lists

config MCUX_COMPONENT_middleware.wireless.framework.platform.ble
    select MCUX_COMPONENT_component.rpmsg_adapter

config MCUX_COMPONENT_middleware.wireless.framework.platform.lowpower
    select MCUX_COMPONENT_middleware.wireless.framework.sfc
    select MCUX_COMPONENT_middleware.wireless.framework.platform.ics
    select MCUX_COMPONENT_middleware.wireless.framework.workq

config MCUX_COMPONENT_middleware.wireless.framework.platform.rng
    select MCUX_COMPONENT_middleware.wireless.framework.platform.ics

endif

# KW47/MCXW72
if MCUX_COMPONENT_middleware.wireless.framework.platform.kw47_mcxw72_nbu

config MCUX_COMPONENT_middleware.wireless.framework.platform.ics
    select MCUX_COMPONENT_middleware.wireless.framework.function_lib
    select MCUX_COMPONENT_middleware.wireless.framework.sfc
    select MCUX_COMPONENT_component.rpmsg_adapter
    imply MCUX_COMPONENT_middleware.wireless.framework.workq
    imply MCUX_COMPONENT_component.mem_manager
    imply MCUX_COMPONENT_component.lists

config MCUX_COMPONENT_middleware.wireless.framework.platform.ble
    select MCUX_COMPONENT_component.rpmsg_adapter

config MCUX_COMPONENT_middleware.wireless.framework.platform.lowpower
    select MCUX_COMPONENT_middleware.wireless.framework.sfc
    select MCUX_COMPONENT_middleware.wireless.framework.platform.dcdc

config MCUX_COMPONENT_middleware.wireless.framework.platform.rng
    select MCUX_COMPONENT_middleware.wireless.framework.platform.ics

endif

# KW43/MCXW70
if MCUX_COMPONENT_middleware.wireless.framework.platform.kw43_mcxw70_nbu

config MCUX_COMPONENT_middleware.wireless.framework.platform.ics
    select MCUX_COMPONENT_middleware.wireless.framework.function_lib
    select MCUX_COMPONENT_middleware.wireless.framework.sfc
    select MCUX_COMPONENT_component.rpmsg_adapter
    imply MCUX_COMPONENT_middleware.wireless.framework.workq
    imply MCUX_COMPONENT_component.mem_manager
    imply MCUX_COMPONENT_component.lists

config MCUX_COMPONENT_middleware.wireless.framework.platform.ble
    select MCUX_COMPONENT_component.rpmsg_adapter

config MCUX_COMPONENT_middleware.wireless.framework.platform.lowpower
    select MCUX_COMPONENT_middleware.wireless.framework.sfc

config MCUX_COMPONENT_middleware.wireless.framework.platform.rng
    select MCUX_COMPONENT_middleware.wireless.framework.platform.ics

endif
```

## mcux/mcux-sdk-ng/middleware/mcuxsdk-middleware-connectivity-framework/services/DBG/Kconfig
```kconfig
# Copyright 2024-2025 NXP
# SPDX-License-Identifier: BSD-3-Clause

menu "Framework Debug"

rsource "sbtsnoop/Kconfig"
rsource "SWO/Kconfig"

config MCUX_COMPONENT_middleware.wireless.framework.dbg.fault_handlers
    bool "Fault Handlers for debug"
    help
      Saves the various Fault Status and Address Registers to help decode
      cause of the fault.

config MCUX_COMPONENT_middleware.wireless.framework.dbg.nbu_debug_on_host
    bool "Extract Debug info from NBU"
    select MCUX_COMPONENT_middleware.wireless.framework.platform.dbg
    depends on MCUX_COMPONENT_middleware.wireless.framework.platform.kw47_mcxw72 # Only supported on KW47-MCXW72 for now
    help
      Allows host core to extract the various debug info saved by the fault handlers module
      on NBU side.

config MCUX_COMPONENT_middleware.wireless.framework.dbg.nbu_debug
    bool "Share NBU Debug info with host"
    depends on MCUX_COMPONENT_middleware.wireless.framework.platform.kw45_mcxw71_nbu || \
               MCUX_COMPONENT_middleware.wireless.framework.platform.kw47_mcxw72_nbu || \
               MCUX_COMPONENT_middleware.wireless.framework.platform.kw43_mcxw70_nbu
    help
      Allows NBU to share debug info with the host

if MCUX_COMPONENT_middleware.wireless.framework.dbg.nbu_debug_on_host || MCUX_COMPONENT_middleware.wireless.framework.dbg.nbu_debug

choice MCUX_COMPONENT_middleware.wireless.framework.dbg.nbu_debug.dbg_struct_selection
    prompt "Debug structure to use"
    config MCUX_COMPONENT_middleware.wireless.framework.dbg.nbu_debug.dbg_struct_legacy
        bool "Legacy debug structure"
        depends on MCUX_COMPONENT_middleware.wireless.framework.platform.kw45_mcxw71_nbu || \
                   MCUX_COMPONENT_middleware.wireless.framework.platform.kw43_mcxw70_nbu # TODO: use refactored structure
    config MCUX_COMPONENT_middleware.wireless.framework.dbg.nbu_debug.dbg_struct
        bool "Refactored debug structure"
        depends on MCUX_COMPONENT_middleware.wireless.framework.platform.kw47_mcxw72_nbu || \
                   MCUX_COMPONENT_middleware.wireless.framework.platform.kw47_mcxw72
endchoice

endif

if MCUX_COMPONENT_middleware.wireless.framework.dbg.fault_handlers

choice MCUX_COMPONENT_middleware.wireless.framework.dbg.fault_handlers.selection
    prompt "Fault handler selection APP / NBU Core"
    config MCUX_COMPONENT_middleware.wireless.framework.dbg.fault_handlers.nbu_core
        bool "Fault Handlers for NBU core"
        depends on  MCUX_COMPONENT_middleware.wireless.framework.platform.kw47_mcxw72_nbu || \
                    MCUX_COMPONENT_middleware.wireless.framework.platform.kw45_mcxw71_nbu || \
                    MCUX_COMPONENT_middleware.wireless.framework.platform.kw43_mcxw70_nbu
        select MCUX_COMPONENT_middleware.wireless.framework.platform.dbg
        select MCUX_COMPONENT_middleware.wireless.framework.dbg.nbu_debug
    config MCUX_COMPONENT_middleware.wireless.framework.dbg.fault_handlers.app_core
        bool "Fault Handlers for APP core"
        depends on  MCUX_COMPONENT_middleware.wireless.framework.platform.kw45_k32w1_mcxw71 || \
                    MCUX_COMPONENT_middleware.wireless.framework.platform.kw47_mcxw72 || \
                    MCUX_COMPONENT_middleware.wireless.framework.platform.kw43_mcxw70
        select MCUX_COMPONENT_utility.debug_console_lite
endchoice

config gDBG_LogInLinkLayerDebugStructEnabled_d
    bool "For NBU usage to Log coredump data in LL RAM"
    default y if MCUX_COMPONENT_middleware.wireless.framework.dbg.fault_handlers.nbu_core
    help
        No debug console is available on NBU core, this allows the data to be stored directly to RAM.
        No prefix in generated macro

endif

endmenu
```

## mcux/mcux-sdk-ng/middleware/mcuxsdk-middleware-connectivity-framework/services/DBG/SWO/Kconfig
```kconfig
# Copyright 2025 NXP
# SPDX-License-Identifier: BSD-3-Clause

menuconfig MCUX_COMPONENT_middleware.wireless.framework.dbg.swo
    bool "Single Wire Output debug"
    help
      This ARM feature is supported by NXP platforms based on ARM cores.
      It allows to export debug information via a single wire (usually UART encoding),
      with very limited impact on real-time execution..

if MCUX_COMPONENT_middleware.wireless.framework.dbg.swo

endif
```

## mcux/mcux-sdk-ng/middleware/mcuxsdk-middleware-connectivity-framework/services/DBG/sbtsnoop/Kconfig
```kconfig
# Copyright 2025 NXP
# SPDX-License-Identifier: BSD-3-Clause

menuconfig MCUX_COMPONENT_middleware.wireless.framework.dbg.sbtsnoop
    bool "btsnoop HCI logging"
    depends on MCUX_COMPONENT_utility.debug_console || MCUX_COMPONENT_utility.debug_console_lite
    select MCUX_COMPONENT_component.osa
    help
      This component provides btsnoop support for HCI logging.

if MCUX_COMPONENT_middleware.wireless.framework.dbg.sbtsnoop
    choice MCUX_COMPONENT_middleware.wireless.framework.dbg.sbtsnoop.port
        prompt "sbtsnoop port selection"
        default MCUX_COMPONENT_middleware.wireless.framework.dbg.sbtsnoop.port.nxp_ble
        config MCUX_COMPONENT_middleware.wireless.framework.dbg.sbtsnoop.port.nxp_ble
            bool "NXP BLE host stack"
            select MCUX_COMPONENT_component.timer_manager
        # Additional port can be added if needed.
    endchoice
endif
```

## mcux/mcux-sdk-ng/middleware/mcuxsdk-middleware-connectivity-framework/services/FSCI/Kconfig
```kconfig
# Copyright 2024 NXP
# SPDX-License-Identifier: BSD-3-Clause

menuconfig MCUX_COMPONENT_middleware.wireless.framework.fsci
    bool "BLE Flexible Serial Communication Interface (FSCI)"
    select MCUX_COMPONENT_middleware.wireless.framework.function_lib
    select MCUX_COMPONENT_component.mem_manager
    select MCUX_COMPONENT_component.reset
    select MCUX_COMPONENT_middleware.wireless.framework.module_info
    select MCUX_COMPONENT_component.osa
    select MCUX_COMPONENT_component.timer_manager
    select MCUX_COMPONENT_component.messaging
    select MCUX_COMPONENT_component.serial_manager
    imply MCUX_COMPONENT_middleware.wireless.framework.platform.ics
    depends on MCUX_COMPONENT_middleware.wireless.framework.platform
    help
      Flexible Serial Communication interface for BLE applications to communicate with NXP BLE host stack.
```

## mcux/mcux-sdk-ng/middleware/mcuxsdk-middleware-connectivity-framework/services/FactoryDataProvider/Kconfig
```kconfig
# Copyright 2024 NXP
# SPDX-License-Identifier: BSD-3-Clause

# FactoryDataProvider configuration options


menuconfig MCUX_COMPONENT_middleware.wireless.framework.factory_data_provider
    bool "Factory Data Provider (FDP) for Matter"
    imply MCUX_COMPONENT_component.mflash_offchip
    select MCUX_COMPONENT_middleware.mbedtls
    select MCUX_COMPONENT_middleware.freertos-kernel
    help
      This module provides an interface to retrieve factory data used in Matter context.

if MCUX_COMPONENT_middleware.wireless.framework.factory_data_provider

endif
```

## mcux/mcux-sdk-ng/middleware/mcuxsdk-middleware-connectivity-framework/services/FileSystem/Kconfig
```kconfig
# Copyright 2024 NXP
# SPDX-License-Identifier: BSD-3-Clause

# FileSystem configuration options


menuconfig MCUX_COMPONENT_middleware.wireless.framework.file_system
    bool "Wrapper to Little FS (FileSystem)"
    select MCUX_COMPONENT_middleware.littlefs
    select MCUX_COMPONENT_middleware.wireless.framework.function_lib
    depends on MCUX_COMPONENT_utility.debug_console || MCUX_COMPONENT_utility.debug_console_lite
    depends on MCUX_COMPONENT_middleware.wireless.framework.platform
    help
      Basic Flash read/write APIs using LittleFS.

if MCUX_COMPONENT_middleware.wireless.framework.file_system

endif
```

## mcux/mcux-sdk-ng/middleware/mcuxsdk-middleware-connectivity-framework/services/FunctionLib/Kconfig
```kconfig
# FunctionLib configuration options

# Copyright 2024 NXP
# SPDX-License-Identifier: BSD-3-Clause

menuconfig MCUX_COMPONENT_middleware.wireless.framework.function_lib
    bool "Memory FunctionLib"
    help
      Memory manipulation wrapper APIs to either toolchain functions or nxp redefined functions.

if MCUX_COMPONENT_middleware.wireless.framework.function_lib

config MCUX_COMPONENT_middleware.wireless.framework.function_lib.use_toolchain_mem_function
    bool "Use toolchain memory functions"
    help
      Use toolchain mem functions like memcpy or memcmp.

endif
```

## mcux/mcux-sdk-ng/middleware/mcuxsdk-middleware-connectivity-framework/services/HWParameter/Kconfig
```kconfig
# Copyright 2024 NXP
# SPDX-License-Identifier: BSD-3-Clause

# HWParameter configuration options


menuconfig MCUX_COMPONENT_middleware.wireless.framework.hw_parameter
    bool "Factory HW/Applications Parameters"
    select MCUX_COMPONENT_component.mem_manager
    select MCUX_COMPONENT_component.flash_adapter
    select MCUX_COMPONENT_middleware.wireless.framework.function_lib
    depends on MCUX_COMPONENT_middleware.wireless.framework.platform
    help
      Read and Write APIs to Flash for Factory HW parameters and Application specific parameters.
```

## mcux/mcux-sdk-ng/middleware/mcuxsdk-middleware-connectivity-framework/services/LowPower/Kconfig
```kconfig
# Copyright 2024-2025 NXP
# SPDX-License-Identifier: BSD-3-Clause

# PWM configuration options

menuconfig MCUX_COMPONENT_middleware.wireless.framework.lowpower
    bool "Low Power Module (PWR)"
    select MCUX_COMPONENT_middleware.wireless.framework.platform.lowpower_timer
    select MCUX_COMPONENT_middleware.wireless.framework.platform.lowpower
    depends on !MCUX_COMPONENT_middleware.wireless.framework.platform.mcxw23
    depends on MCUX_COMPONENT_middleware.wireless.framework.platform
    help
      Low-power wrapper APIs to SDK power manager component for connectivity platforms.

if MCUX_COMPONENT_middleware.wireless.framework.lowpower

config MCUX_COMPONENT_middleware.wireless.framework.lowpower.cli
    bool "Low Power CLI"
    select MCUX_COMPONENT_middleware.freertos-kernel
    select MCUX_COMPONENT_utility.debug_console
    depends on !MCUX_COMPONENT_middleware.wireless.framework.platform.mcxw23
    help
        Low Power CLI APIs in order to configure low power through a serial interface using the SDK debug console.

endif
```

## mcux/mcux-sdk-ng/middleware/mcuxsdk-middleware-connectivity-framework/services/MWSCoexistence/Kconfig
```kconfig
# Copyright 2025 NXP
# SPDX-License-Identifier: BSD-3-Clause

# MWSCoexistence configuration options


menuconfig MCUX_COMPONENT_middleware.wireless.framework.mws
    bool "Mobile Wireless Standard interface"
    select MCUX_COMPONENT_component.osa
    help
      Mobile Wireless Standard interface.

if MCUX_COMPONENT_middleware.wireless.framework.mws

endif
```

## mcux/mcux-sdk-ng/middleware/mcuxsdk-middleware-connectivity-framework/services/ModuleInfo/Kconfig
```kconfig
# Copyright 2024 NXP
# SPDX-License-Identifier: BSD-3-Clause

# FModuleInfo configuration options


menuconfig MCUX_COMPONENT_middleware.wireless.framework.module_info
    bool "ModuleInfo"
    select MCUX_COMPONENT_middleware.wireless.framework.function_lib
    help
      Version module register APIs in order for connectivity component to register Module version, extracted by FSCI.

if MCUX_COMPONENT_middleware.wireless.framework.module_info

endif
```
