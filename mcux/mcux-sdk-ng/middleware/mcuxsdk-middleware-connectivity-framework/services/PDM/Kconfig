## mcux/mcux-sdk-ng/middleware/mcuxsdk-middleware-connectivity-framework/services/PDM/Kconfig
```kconfig
# Copyright 2024 NXP
# SPDX-License-Identifier: BSD-3-Clause

# PDM Support configuration

config MCUX_COMPONENT_middleware.wireless.framework.pdm
    bool "Persistent Data Manager (PDM) for Zigbee"
    help
        Persistent Data Manager APIs.
```

## mcux/mcux-sdk-ng/middleware/mcuxsdk-middleware-connectivity-framework/services/PDUM/Kconfig
```kconfig
# Copyright 2024 NXP
# SPDX-License-Identifier: BSD-3-Clause

# PDUM Support configuration

config MCUX_COMPONENT_middleware.wireless.framework.pdum
    bool "Protocol Data Unit Manager (PDUM) for Zigbee"
    help
        Protocol Data Unit Manager APIs for Zigbee.
```

## mcux/mcux-sdk-ng/middleware/mcuxsdk-middleware-connectivity-framework/services/SFC/Kconfig
```kconfig
# Copyright 2024-2025 NXP
# SPDX-License-Identifier: BSD-3-Clause

# SFC configuration options

config MCUX_COMPONENT_middleware.wireless.framework.sfc
    bool "Smart Frequency Calibration for FRO32K (SFC)"
    depends on MCUX_COMPONENT_middleware.wireless.framework.platform.kw47_mcxw72 || \
               MCUX_COMPONENT_middleware.wireless.framework.platform.kw45_k32w1_mcxw71 || \
               MCUX_COMPONENT_middleware.wireless.framework.platform.kw47_mcxw72_nbu || \
               MCUX_COMPONENT_middleware.wireless.framework.platform.kw45_mcxw71_nbu || \
               MCUX_COMPONENT_middleware.wireless.framework.platform.kw43_mcxw70 || \
               MCUX_COMPONENT_middleware.wireless.framework.platform.kw43_mcxw70_nbu
    help
      Collection of APIs for FRO32K calibration when XTAL32K is not present on the board.

if MCUX_COMPONENT_middleware.wireless.framework.sfc

# Use a non-visible symbol to resolve driver dependencies on NBU side without bloating the main symbol with multiple if
config MCUX_COMPONENT_middleware.wireless.framework.sfc.deps
    bool
    default y
    select MCUX_COMPONENT_driver.sfa
    select MCUX_COMPONENT_driver.ccm32k
    depends on MCUX_COMPONENT_middleware.wireless.framework.platform.kw47_mcxw72_nbu || \
               MCUX_COMPONENT_middleware.wireless.framework.platform.kw45_mcxw71_nbu

endif
```

## mcux/mcux-sdk-ng/middleware/mcuxsdk-middleware-connectivity-framework/services/SecLib_RNG/Kconfig
```kconfig
# Copyright 2024-2025 NXP
# SPDX-License-Identifier: BSD-3-Clause

menuconfig MCUX_COMPONENT_middleware.wireless.framework.seclib_rng
    bool "Security librairies - Random Number Generator (SecLib_RNG)"
    #select MCUX_COMPONENT_component.osa
    select MCUX_COMPONENT_component.mem_manager
    #select MCUX_COMPONENT_component.messaging
    select MCUX_COMPONENT_middleware.wireless.framework.function_lib
    select MCUX_COMPONENT_middleware.wireless.framework.platform.rng
    imply MCUX_COMPONENT_middleware.wireless.framework.platform.ics
    imply MCUX_COMPONENT_middleware.wireless.framework.workq
    depends on MCUX_COMPONENT_middleware.wireless.framework.platform
    help
      Crypto algorithms API and Random number generator APIs to connectivity applications.

if MCUX_COMPONENT_middleware.wireless.framework.seclib_rng

    choice MCUX_COMPONENT_middleware.wireless.framework.seclib_rng_port
        prompt "SecLib port selection"
        default MCUX_COMPONENT_middleware.wireless.framework.seclib_rng_port.sw
        config MCUX_COMPONENT_middleware.wireless.framework.seclib_rng_port.sw
            bool "Use Software Algorithm"
            select MCUX_COMPONENT_component.rng_adapter_interface if MCUX_COMPONENT_middleware.wireless.framework.platform.kw43_mcxw70
        config MCUX_COMPONENT_middleware.wireless.framework.seclib_rng_port.secure_subsystem
            bool "Use Secure Subsystem"
            select MCUX_COMPONENT_middleware.wireless.framework.platform.crypto
            select MCUX_COMPONENT_middleware.secure-subsystem
        config MCUX_COMPONENT_middleware.wireless.framework.seclib_rng_port.mbedtls
            bool "Use MbedTLS"
            select MCUX_COMPONENT_middleware.wireless.framework.platform.crypto
            select MCUX_COMPONENT_middleware.mbedtls
        config MCUX_COMPONENT_middleware.wireless.framework.seclib_rng_port.psa
            bool "Use experimental PSA"
            select MCUX_COMPONENT_middleware.mbedtls3x.port.psa_crypto_config
            select MCUX_COMPONENT_middleware.mbedtls3x.crypto
            select MCUX_COMPONENT_middleware.mbedtls3x.p256m
            select MCUX_COMPONENT_middleware.wireless.framework.platform.crypto
        config  MCUX_COMPONENT_middleware.wireless.framework.seclib_rng_port.custom
            bool "Use custom Seclib_RNG"
    endchoice

endif
```

## mcux/mcux-sdk-ng/middleware/mcuxsdk-middleware-connectivity-framework/services/Sensors/Kconfig
```kconfig
# Sensors configuration options

# Copyright 2024-2025 NXP
# SPDX-License-Identifier: BSD-3-Clause

menuconfig MCUX_COMPONENT_middleware.wireless.framework.sensors
    bool "Sensors for Battery/Temperature measurements"
    select MCUX_COMPONENT_middleware.wireless.framework.platform.sensors
    select MCUX_COMPONENT_component.osa
    select MCUX_COMPONENT_component.timer_manager
    select MCUX_COMPONENT_middleware.wireless.framework.workq
    imply MCUX_COMPONENT_middleware.wireless.framework.platform.ics
    depends on MCUX_COMPONENT_middleware.wireless.framework.platform
    help
      Sensors APIs for Battery/Temperature measurements.

if MCUX_COMPONENT_middleware.wireless.framework.sensors

endif
```

## mcux/mcux-sdk-ng/middleware/mcuxsdk-middleware-connectivity-framework/services/WorkQ/Kconfig
```kconfig
# Copyright 2025 NXP
# SPDX-License-Identifier: BSD-3-Clause

menuconfig MCUX_COMPONENT_middleware.wireless.framework.workq
    bool "Simple workqueue threads"
    select MCUX_COMPONENT_component.osa
    select MCUX_COMPONENT_component.lists
    help
      Use workqueues to defer processing to shared threads.

if MCUX_COMPONENT_middleware.wireless.framework.workq
  menu "Work queue config"
      config FWK_SYSWORKQ_STACK_SIZE
          int "WorkQueue stack size"
          default 2200 if MCUX_COMPONENT_middleware.wireless.framework.seclib_rng_port.mbedtls \
                          && MCUX_COMPONENT_middleware.wireless.framework.platform.rw61x
          default 1700 if MCUX_COMPONENT_middleware.wireless.framework.seclib_rng_port.mbedtls \
                          && MCUX_COMPONENT_utilities.gcov
          default 1500 if MCUX_COMPONENT_middleware.wireless.framework.seclib_rng_port.mbedtls
          default 750  if MCUX_COMPONENT_utilities.gcov
          default 608
          help
              Macro to set work queue task stack size.
      config FWK_SYSWORKQ_PRIO
          int "WorkQueue task priority"
          default 4
          help
              Macro to set work queue task priority.
  endmenu
endif
```

## mcux/mcux-sdk-ng/middleware/mcuxsdk-middleware-connectivity-framework/zephyr/Kconfig
```kconfig
# Copyright 2024 NXP
# SPDX-License-Identifier: BSD-3-Clause

menu "Zephyr Services"

config MCUX_COMPONENT_middleware.wireless.framework.zephyr_common
    bool
    default y
    depends on NVS || SETTINGS

rsource "lib/Kconfig"
rsource "subsys/Kconfig"
rsource "port/Kconfig"
endmenu
```

## mcux/mcux-sdk-ng/middleware/mcuxsdk-middleware-connectivity-framework/zephyr/lib/crc/Kconfig
```kconfig
# Copyright (c) 2016,2023 Intel Corporation
# Copyright 2024 NXP
# SPDX-License-Identifier: Apache-2.0

config CRC
	bool
	help
	  Enable use of CRC.

if CRC
endif
```

## mcux/mcux-sdk-ng/middleware/mcuxsdk-middleware-connectivity-framework/zephyr/port/Kconfig
```kconfig
# Copyright 2024 NXP
# SPDX-License-Identifier: BSD-3-Clause

menu "NXP port configuration"

rsource "nvs/Kconfig"
rsource "settings/Kconfig"

endmenu
```

## mcux/mcux-sdk-ng/middleware/mcuxsdk-middleware-connectivity-framework/zephyr/port/nvs/Kconfig
```kconfig
# NVS port configuration options

# Copyright 2024 NXP
# SPDX-License-Identifier: BSD-3-Clause

config MCUX_COMPONENT_middleware.wireless.framework.zephyr_port.nvs
    bool
    select MCUX_COMPONENT_component.osa
    select MCUX_COMPONENT_middleware.wireless.framework.function_lib
    depends on MCUX_COMPONENT_middleware.wireless.framework.platform
    help
      This Component provides a port of Zephyr NVS file system for connectivity Applications.

if MCUX_COMPONENT_middleware.wireless.framework.zephyr_port.nvs
    choice MCUX_COMPONENT_middleware.wireless.framework.zephyr_port.nvs.flash_selection
	prompt "Select flash type for NVS file system"
	default MCUX_COMPONENT_middleware.wireless.framework.zephyr_port.nvs.external_flash
	config MCUX_COMPONENT_middleware.wireless.framework.zephyr_port.nvs.external_flash
		bool "External flash"
		select MCUX_COMPONENT_middleware.wireless.framework.platform.external_flash
		help
			Use external flash for NVS file system.
	config MCUX_COMPONENT_middleware.wireless.framework.zephyr_port.nvs.internal_flash
		bool "Internal flash"
		select MCUX_COMPONENT_component.flash_adapter
		select MCUX_COMPONENT_middleware.wireless.framework.platform.internal_flash
		help
			Use internal flash for NVS file system.
endchoice

config MCUX_COMPONENT_middleware.wireless.framework.zephyr_port.nvs.stats
    bool "NVS Statistics"
    help 
		Enable Non-volatile storage statistics.
endif
```

## mcux/mcux-sdk-ng/middleware/mcuxsdk-middleware-connectivity-framework/zephyr/port/settings/Kconfig
```kconfig
# Settings configuration options

# Copyright 2024 NXP
# SPDX-License-Identifier: BSD-3-Clause

config MCUX_COMPONENT_middleware.wireless.framework.zephyr_port.settings
    bool
    select MCUX_COMPONENT_component.osa
    depends on MCUX_COMPONENT_middleware.wireless.framework.platform
    help
      This Component is a port of Zephyr Settings for connectivity Applications.

if MCUX_COMPONENT_middleware.wireless.framework.zephyr_port.settings

config MCUX_COMPONENT_middleware.wireless.framework.zephyr_port.settings.redefine_api
    bool "Re-define API name"
    default n
    help
      Re-define settings API name to avoid Multiple Definition errors
      when build with other components

endif
```

## mcux/mcux-sdk-ng/middleware/mcuxsdk-middleware-connectivity-framework/zephyr/subsys/Kconfig
```kconfig
# Subsystem configuration options

# Copyright (c) 2016-2017 Intel Corporation
# Copyright (c) 2021 Nordic Semiconductor
# Copyright 2024 NXP
# SPDX-License-Identifier: Apache-2.0
menu "File Systems"
rsource "fs/Kconfig"
endmenu

menu "Settings"
rsource "settings/Kconfig"
endmenu
```

## mcux/mcux-sdk-ng/middleware/mcuxsdk-middleware-connectivity-framework/zephyr/subsys/fs/Kconfig
```kconfig
# Copyright (c) 2016 Intel Corporation
# Copyright (c) 2020 Nordic Semiconductor (ASA)
# Copyright 2024 NXP
# SPDX-License-Identifier: Apache-2.0

rsource "nvs/Kconfig"
```

## mcux/mcux-sdk-ng/middleware/mcuxsdk-middleware-connectivity-framework/zephyr/subsys/settings/Kconfig
```kconfig
# Copyright (c) 2018 Nordic Semiconductor ASA
# Copyright 2024 NXP
# SPDX-License-Identifier: Apache-2.0

menuconfig SETTINGS
	bool "Settings"
	select MCUX_COMPONENT_middleware.wireless.framework.zephyr_port.settings
	help
	  The settings subsystem allows its users to serialize and
	  deserialize state in memory into and from non-volatile memory.
	  It supports several back-ends to store and load serialized data from
	  and it can do so atomically for all involved modules.

if SETTINGS

config SETTINGS_RUNTIME
	bool "runtime storage back-end"
	help
	  Enables runtime storage back-end.

config SETTINGS_DYNAMIC_HANDLERS
	bool "dynamic settings handlers"
	default y
	help
	  Enables the use of dynamic settings handlers

# Hidden option to enable encoding length into settings entry
config SETTINGS_ENCODE_LEN
	bool

choice SETTINGS_BACKEND
	prompt "Storage back-end"
	default SETTINGS_NVS
	help
	  Storage back-end to be used by the settings subsystem.

config SETTINGS_NVS
	bool "NVS non-volatile storage support"
	select NVS
	help
	  Enables NVS storage support

if SETTINGS_NVS

config SETTINGS_NVS_NAME_CACHE
	bool "NVS name lookup cache"
	help
	  Enable NVS name lookup cache, used to reduce the Settings name
	  lookup time.

config SETTINGS_NVS_NAME_CACHE_SIZE
	int "NVS name lookup cache size"
	default 128
	range 1 65535
	depends on SETTINGS_NVS_NAME_CACHE
	help
	  Number of entries in Settings NVS name cache.

endif # SETTINGS_NVS

config SETTINGS_CUSTOM
	bool "CUSTOM"
	help
	  Use a custom settings storage back-end.

endchoice

config SETTINGS_NVS_SECTOR_SIZE_MULT
	int "Sector size of the NVS settings area"
	default 1
	depends on SETTINGS_NVS
	help
	  The sector size to use for the NVS settings area as a multiple of
	  FLASH_ERASE_BLOCK_SIZE.

config SETTINGS_NVS_SECTOR_COUNT
	int "Sector count of the NVS settings area"
	default 8
	depends on SETTINGS_NVS
	help
	  Number of sectors used for the NVS settings area

endif # SETTINGS
```
